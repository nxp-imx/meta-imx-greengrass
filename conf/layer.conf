## conf/layer.conf
```bitbake
# We have a conf and classes directory, add to BBPATH
BBPATH .= ":${LAYERDIR}"
# We have recipes-* directories, add to BBFILES
BBFILES += "${LAYERDIR}/recipes-*/*/*.bb \
            ${LAYERDIR}/recipes-*/*/*.bbappend"

BBFILE_COLLECTIONS += "imx-greengrass"
BBFILE_PATTERN_imx-greengrass = "^${LAYERDIR}/"

LAYERSERIES_COMPAT_imx-greengrass = "zeus"
```
